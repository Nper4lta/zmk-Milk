#include <behaviors.dtsi>
#include <dt-bindings/zmk/keys.h>
#include <dt-bindings/zmk/bt.h>

/ {
    keymap {
        compatible = "zmk,keymap";

        default_layer {
            bindings = <
                &kp P
                &mo 1
            >;
        };

        bl_layer {
            bindings = <
                &bt BT_SEL 1
                &bt BT_CLR
            >;
        };
    };
};